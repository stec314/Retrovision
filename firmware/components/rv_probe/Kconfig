## firmware/components/rv_probe/Kconfig
```kconfig
menu "Retrovision probe"

    config RV_RELAY_UART_TX_GPIO
        int "Relay link: probe TX pin (to the relay's RX)"
        default 23 if IDF_TARGET_ESP32C5
        default 17 if IDF_TARGET_ESP32
        default 5
        help
            Used only when the probe is paired for a relay link (LINK_KIND_RELAY).
            ESP32-C5 DevKitC/Waveshare: GPIO23 is free (not strapping, USB or console).

    config RV_RELAY_UART_RX_GPIO
        int "Relay link: probe RX pin (from the relay's TX)"
        default 24 if IDF_TARGET_ESP32C5
        default 16 if IDF_TARGET_ESP32
        default 6

    config RV_RELAY_UART_BAUD
        int "Relay link baud rate"
        default 921600
        help
            Must match the relay firmware. The BLE side (~20-60 kB/s) is the bottleneck,
            not the wire.

endmenu
```

## firmware/relay-esp32s3/main/Kconfig.projbuild
```kconfig
menu "Retrovision relay"

    config RV_RELAY_TX_GPIO
        int "Relay TX pin (to the probe's RX)"
        default 43
        help
            XIAO ESP32-S3: GPIO43 is the pad labelled D6/TX.

    config RV_RELAY_RX_GPIO
        int "Relay RX pin (from the probe's TX)"
        default 44
        help
            XIAO ESP32-S3: GPIO44 is the pad labelled D7/RX.

    config RV_RELAY_BAUD
        int "UART baud rate (must match the probe)"
        default 921600

    config RV_RELAY_LED_GPIO
        int "Status LED GPIO (-1 = none)"
        default 21

    config RV_RELAY_LED_ACTIVE_LOW
        bool "Status LED is active low"
        default y

endmenu
```
